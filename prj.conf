## CMakeLists.txt
```
# Add the USB MIDI driver module. CMAKE_CURRENT_SOURCE_DIR is 
# the dir containing the sample app's CMakeLists.txt, i.e the 
# repository root dir, which is also the root dir of the
# driver module.
list(APPEND EXTRA_ZEPHYR_MODULES ${CMAKE_CURRENT_SOURCE_DIR})

cmake_minimum_required(VERSION 3.20.0)

find_package(Zephyr REQUIRED HINTS $ENV{ZEPHYR_BASE})
project(usb_midi_sample)

target_sources(app PRIVATE src/main.c)
```

## Kconfig
```
source "Kconfig.zephyr"

# Sample app config vars

config LED_FLASH_DURATION_MS
	int
    default 60
config SYSEX_TX_TEST_MSG_CABLE_NUM   
    int "Cable number to use for sysex test messages"
    default 0 
config SYSEX_TX_TEST_MSG_SIZE        
    int "Size in bytes of outgoing sysex test messages"
    default 170000
config SYSEX_ECHO_ENABLED 			  
    bool "Echo incoming sysex messages?"
    default n
config SYSEX_ECHO_MAX_LENGTH         
    int "Echo at most this many bytes of incoming sysex messages (last byte of truncated messages is replaced with 0xf7)"
    default 65536
config TX_PERIODIC_NOTE_ENABLED      
    bool "Send note on/off periodically?"
    default y
config TX_PERIODIC_NOTE_INTERVAL_MS  
    int 
    default 500
config TX_PERIODIC_NOTE_NUMBER	      
    int
    default 69
config TX_PERIODIC_NOTE_VELOCITY     
    int 
    default 127
config SAMPLE_APP_MANUFACTURER_NAME
    string "Sample app USB device manufacturer name"
config SAMPLE_APP_PRODUCT_NAME
    string "Sample app USB device name"
config SAMPLE_APP_DEVICE_PID
    hex "Sample app USB device product id"
config SAMPLE_APP_DEVICE_VID
    hex "Sample app USB device vendor id"
```

## prj.conf
```kconfig
#############################################
# Legacy USB stack
#############################################
CONFIG_USB_DEVICE_STACK=y
# enables buffered tx.
CONFIG_USB_DEVICE_SOF=y
CONFIG_USB_DEVICE_MANUFACTURER="zephyr"
CONFIG_USB_DEVICE_PRODUCT="zephyr-usb-midi"
CONFIG_USB_DEVICE_PID=0x1000
CONFIG_USB_DEVICE_VID=0x2FE3

#############################################
# New USB stack
#############################################
# CONFIG_USB_DEVICE_STACK_NEXT=y
# Device metadata for use with the new USB stack
CONFIG_SAMPLE_APP_MANUFACTURER_NAME="zephyr"
CONFIG_SAMPLE_APP_PRODUCT_NAME="zephyr-usb-midi"
CONFIG_SAMPLE_APP_DEVICE_PID=0x1000
CONFIG_SAMPLE_APP_DEVICE_VID=0x2FE3

# Enable USB MIDI device class
CONFIG_USB_DEVICE_MIDI=y

# USB MIDI stuff
CONFIG_USB_MIDI_NUM_INPUTS=2
CONFIG_USB_MIDI_NUM_OUTPUTS=3
# CONFIG_USB_MIDI_CUSTOM_JACK_NAMES=y
CONFIG_USB_MIDI_INPUT_JACK_0_NAME="Custom input name 0"
CONFIG_USB_MIDI_INPUT_JACK_1_NAME="Custom input name 1"
CONFIG_USB_MIDI_OUTPUT_JACK_0_NAME="Custom output name 0"
CONFIG_USB_MIDI_OUTPUT_JACK_1_NAME="Custom output name 1"
CONFIG_USB_MIDI_OUTPUT_JACK_2_NAME="Custom output name 2"

# Sample app config vars
CONFIG_SYSEX_ECHO_ENABLED=n
CONFIG_TX_PERIODIC_NOTE_ENABLED=y

# Debug stuff
CONFIG_DEBUG_OPTIMIZATIONS=y
CONFIG_DEBUG_THREAD_INFO=y
CONFIG_LOG=y
CONFIG_USB_MIDI_LOG_LEVEL_DBG=y
CONFIG_LOG_BUFFER_SIZE=65536
CONFIG_UDC_DRIVER_LOG_LEVEL_INF=y
CONFIG_USBD_LOG_LEVEL_INF=y
# CONFIG_ASSERT=y
```

## src/main.c
```c
#include <zephyr/init.h>
#include <zephyr/kernel.h>
#include <zephyr/usb/usbd.h>
#include <zephyr/drivers/gpio.h>
#include <usb_midi/usb_midi.h>
#if defined(CLOCK_FEATURE_HFCLK_DIVIDE_PRESENT) || NRF_CLOCK_HAS_HFCLK192M
#include <nrfx_clock.h>
#endif

#include <zephyr/logging/log.h>
LOG_MODULE_REGISTER(usb_midi_sample);

struct k_work button_press_work;
struct k_work event_tx_work;
struct k_work_delayable rx_led_off_work;
struct k_work_delayable tx_led_off_work;
static void send_next_sysex_chunk();

/************************ App state ************************/
struct sample_app_state_t {
	int usb_midi_is_available;
	int tx_note_off;
	
	int sysex_rx_byte_count;
	uint8_t sysex_rx_bytes[CONFIG_SYSEX_ECHO_MAX_LENGTH];
	int64_t sysex_rx_start_time;

	int sysex_tx_is_echo;
	int sysex_tx_byte_count;
	int sysex_tx_msg_size;
	int sysex_tx_in_progress;
	int sysex_tx_cable_num;
	int64_t sysex_tx_start_time;
};

static struct sample_app_state_t sample_app_state = {.usb_midi_is_available = 0,
							 .sysex_rx_byte_count = 0,
							 .sysex_tx_in_progress = 0,
							 .sysex_rx_start_time = 0,
						     .sysex_tx_byte_count = 0,
							 .sysex_tx_start_time = 0,
							 .sysex_tx_is_echo = 0,
						     .sysex_tx_in_progress = 0,
							 .sysex_tx_cable_num = 0,
						     .tx_note_off = 0,
							 .sysex_rx_byte_count = 0
							 };

static void log_sysex_transfer_time(int is_tx, int cable_num, int num_bytes, int time_ms) {
	float bytes_per_s = time_ms == 0.0f ? 0.0f : (float)num_bytes / (0.001f * time_ms);
	LOG_INF("sysex %s done | cable %d | %d bytes in %d ms | %d bytes/s", is_tx ? "tx" : "rx", cable_num,
		num_bytes, (int)time_ms, (int)bytes_per_s);
}

static void sysex_tx_will_start(int is_echo, int msg_size, int cable_num) {
	__ASSERT_NO_MSG(sample_app_state.sysex_tx_in_progress == 0);
	sample_app_state.sysex_tx_in_progress = 1;
	sample_app_state.sysex_tx_is_echo = is_echo;
	sample_app_state.sysex_tx_byte_count = 0;
	sample_app_state.sysex_tx_msg_size = msg_size;
	sample_app_state.sysex_tx_cable_num = cable_num;
	sample_app_state.sysex_tx_start_time = k_uptime_get();
}

/************************ LEDs ************************/
static struct gpio_dt_spec usb_midi_available_led = GPIO_DT_SPEC_GET(DT_ALIAS(led0), gpios);
static struct gpio_dt_spec midi_rx_led = GPIO_DT_SPEC_GET(DT_ALIAS(led1), gpios);
static struct gpio_dt_spec midi_tx_led = GPIO_DT_SPEC_GET(DT_ALIAS(led2), gpios);

static void init_leds()
{
	gpio_pin_configure_dt(&usb_midi_available_led, GPIO_OUTPUT_ACTIVE);
	gpio_pin_set_dt(&usb_midi_available_led, 0);

	gpio_pin_configure_dt(&midi_rx_led, GPIO_OUTPUT_ACTIVE);
	gpio_pin_set_dt(&midi_rx_led, 0);

	gpio_pin_configure_dt(&midi_tx_led, GPIO_OUTPUT_ACTIVE);
	gpio_pin_set_dt(&midi_tx_led, 0);
}

static void set_usb_midi_available_led(int is_available)
{
	gpio_pin_set_dt(&usb_midi_available_led, is_available);
}

static void flash_tx_led()
{
	gpio_pin_set_dt(&midi_tx_led, 1);
	k_work_cancel_delayable(&tx_led_off_work);
	k_work_schedule(&tx_led_off_work, Z_TIMEOUT_MS(CONFIG_LED_FLASH_DURATION_MS));
}

static void flash_rx_led()
{
	gpio_pin_set_dt(&midi_rx_led, 1);
	k_work_cancel_delayable(&rx_led_off_work);
	k_work_schedule(&rx_led_off_work, Z_TIMEOUT_MS(CONFIG_LED_FLASH_DURATION_MS));
}

/****************** Work queue callbacks ******************/

void on_event_tx(struct k_work *item)
{
	if (sample_app_state.usb_midi_is_available && !sample_app_state.sysex_tx_in_progress) {
		uint8_t note = CONFIG_TX_PERIODIC_NOTE_NUMBER;
		uint8_t vel = CONFIG_TX_PERIODIC_NOTE_VELOCITY;
		for (int i = 0; i < 3; i++) {
			uint8_t msg[3] = {sample_app_state.tx_note_off ? 0x80 : 0x90, note + 2 * i, vel };
			usb_midi_tx(0, msg);
		}
		flash_tx_led();
		sample_app_state.tx_note_off = !sample_app_state.tx_note_off;
	}
}

void on_button_press(struct k_work *item)
{
	if (sample_app_state.usb_midi_is_available && !sample_app_state.sysex_tx_in_progress) {
		sysex_tx_will_start(0, CONFIG_SYSEX_TX_TEST_MSG_SIZE, CONFIG_SYSEX_TX_TEST_MSG_CABLE_NUM);
		send_next_sysex_chunk();
	}
}

void on_rx_led_off(struct k_work *item)
{
	gpio_pin_set_dt(&midi_rx_led, 0);
}

void on_tx_led_off(struct k_work *item)
{
	gpio_pin_set_dt(&midi_tx_led, 0);
}

/************************ Buttons ************************/

static struct gpio_dt_spec button = GPIO_DT_SPEC_GET_OR(DT_ALIAS(sw0), gpios, {0});
static struct gpio_callback button_cb_data;

static void button_pressed(const struct device *dev, struct gpio_callback *cb, uint32_t pins)
{
	k_work_submit(&button_press_work);
}

static void init_button()
{
	__ASSERT_NO_MSG(device_is_ready(button.port));
	int ret = gpio_pin_configure_dt(&button, GPIO_INPUT);
	__ASSERT_NO_MSG(ret == 0);
	ret = gpio_pin_interrupt_configure_dt(&button, GPIO_INT_EDGE_TO_ACTIVE);
	__ASSERT_NO_MSG(ret == 0);

	gpio_init_callback(&button_cb_data, button_pressed, BIT(button.pin));
	ret = gpio_add_callback(button.port, &button_cb_data);
	__ASSERT_NO_MSG(ret == 0);
}

/****************** USB MIDI callbacks ******************/

static void midi_message_cb(uint8_t *bytes, uint8_t num_bytes, uint8_t cable_num)
{
	flash_rx_led();
}

static void sysex_start_cb(uint8_t cable_num)
{
	sample_app_state.sysex_rx_start_time = k_uptime_get();
	sample_app_state.sysex_rx_byte_count = 0;
	sample_app_state.sysex_rx_bytes[0] = 0xf0; 
	sample_app_state.sysex_rx_byte_count++;
	flash_rx_led();
}

static void sysex_data_cb(uint8_t *data_bytes, uint8_t num_data_bytes, uint8_t cable_num)
{
#ifdef CONFIG_SYSEX_ECHO_ENABLED
	for (int i = 0; i < num_data_bytes; i++) {
		int dest_idx = sample_app_state.sysex_rx_byte_count + i;
		if (dest_idx == CONFIG_SYSEX_ECHO_MAX_LENGTH - 1) {
			// reached max length. end stored message prematurely by adding
			// end of sysex status byte.
			sample_app_state.sysex_rx_bytes[dest_idx] = 0xf7;
		}
		else if (dest_idx >= CONFIG_SYSEX_ECHO_MAX_LENGTH) {
			break;
		} 
		else {
			sample_app_state.sysex_rx_bytes[dest_idx] = data_bytes[i];
		}
	}
#endif
	sample_app_state.sysex_rx_byte_count += num_data_bytes;
}

static void sysex_end_cb(uint8_t cable_num)
{
	if (sample_app_state.sysex_rx_byte_count < CONFIG_SYSEX_ECHO_MAX_LENGTH) {
		sample_app_state.sysex_rx_bytes[sample_app_state.sysex_rx_byte_count] = 0xf7;
	}
	sample_app_state.sysex_rx_byte_count++; // account for the last 0xf7
	u_int64_t dt_ms = k_uptime_get() - sample_app_state.sysex_rx_start_time;
	log_sysex_transfer_time(0, cable_num, sample_app_state.sysex_rx_byte_count, dt_ms);
	flash_rx_led();
#ifdef CONFIG_SYSEX_ECHO_ENABLED
	LOG_INF("Echoing received sysex");
	sysex_tx_will_start(1, sample_app_state.sysex_rx_byte_count < CONFIG_SYSEX_ECHO_MAX_LENGTH ? sample_app_state.sysex_rx_byte_count : CONFIG_SYSEX_ECHO_MAX_LENGTH, cable_num);
	send_next_sysex_chunk();
#endif
}

static void usb_midi_available_cb(int is_available)
{
	sample_app_state.usb_midi_is_available = is_available;
	set_usb_midi_available_led(is_available);
	if (is_available) {
		sample_app_state.tx_note_off = 0;
		sample_app_state.sysex_tx_in_progress = 0;
	}
}

static uint8_t get_next_sysex_tx_byte() {
	if (sample_app_state.sysex_tx_is_echo) {
		return sample_app_state.sysex_rx_bytes[sample_app_state.sysex_tx_byte_count];
	} 
	else {
		if (sample_app_state.sysex_tx_byte_count == 0) {
			return 0xf0;
		}
		else if (sample_app_state.sysex_tx_byte_count == sample_app_state.sysex_tx_msg_size - 1) {
			return 0xf7;
		} 
		else {
			return sample_app_state.sysex_tx_byte_count % 100;
		}	
	}
}

static void send_next_sysex_chunk() {
	__ASSERT_NO_MSG(sample_app_state.sysex_tx_in_progress);

	// flash_tx_led();

	while (1) {
		int sysex_msg_size = sample_app_state.sysex_tx_msg_size;

		uint8_t chunk[3] = {0, 0, 0};
		int chunk_size = 0;
		for (int i = 0; i < 3; i++) {
			uint8_t next_sysex_byte = get_next_sysex_tx_byte();
			chunk[i] = next_sysex_byte;
			chunk_size++;
			if (sample_app_state.sysex_tx_byte_count == 0) {
				break;
			}

			if (sample_app_state.sysex_tx_byte_count + chunk_size == sysex_msg_size) {
				break;
			}
		}
		sample_app_state.sysex_tx_byte_count += chunk_size;

		enum usb_midi_error_t tx_result = usb_midi_tx(sample_app_state.sysex_tx_cable_num, chunk);
		if (tx_result == USB_MIDI_TX_FIFO_FULL) {
			break;
		} else if (sample_app_state.sysex_tx_byte_count == sysex_msg_size) {
			// No more data to add to tx packet. Send it, then we're done.
			flash_tx_led();
			u_int64_t dt_ms = k_uptime_get() - sample_app_state.sysex_tx_start_time;
			log_sysex_transfer_time(1, sample_app_state.sysex_tx_cable_num, sysex_msg_size, dt_ms);
			sample_app_state.sysex_tx_in_progress = 0;
			break;
		}
	}
}

static void usb_midi_tx_done_cb()
{
	if (sample_app_state.sysex_tx_in_progress) {
		send_next_sysex_chunk();
	}
}

/****************** Sample app ******************/

#ifdef CONFIG_USB_DEVICE_STACK_NEXT
USBD_DESC_CONFIG_DEFINE(fs_cfg_desc, "FS Configuration");
USBD_DESC_CONFIG_DEFINE(hs_cfg_desc, "HS Configuration");

/* doc configuration instantiation start */
// TODO: set remote wakeup and self powered somwhere
static const uint8_t attributes = (IS_ENABLED(CONFIG_SAMPLE_USBD_SELF_POWERED) ?
				   USB_SCD_SELF_POWERED : 0) |
				  (IS_ENABLED(CONFIG_SAMPLE_USBD_REMOTE_WAKEUP) ?
				   USB_SCD_REMOTE_WAKEUP : 0);

/* Full speed configuration */
#define CONFIG_SAMPLE_USBD_MAX_POWER 250
USBD_CONFIGURATION_DEFINE(sample_fs_config,
			  attributes,
			  CONFIG_SAMPLE_USBD_MAX_POWER, &fs_cfg_desc);

/* High speed configuration */
USBD_CONFIGURATION_DEFINE(sample_hs_config,
			  attributes,
			  CONFIG_SAMPLE_USBD_MAX_POWER, &hs_cfg_desc);
/* doc configuration instantiation end */

USBD_DEVICE_DEFINE(usbd,
		   DEVICE_DT_GET(DT_NODELABEL(zephyr_udc0)),
		   CONFIG_SAMPLE_APP_DEVICE_VID, CONFIG_SAMPLE_APP_DEVICE_PID);

USBD_DESC_LANG_DEFINE(sample_lang);
USBD_DESC_MANUFACTURER_DEFINE(sample_mfr, CONFIG_SAMPLE_APP_MANUFACTURER_NAME);
USBD_DESC_PRODUCT_DEFINE(sample_product, CONFIG_SAMPLE_APP_PRODUCT_NAME);
USBD_DESC_SERIAL_NUMBER_DEFINE(sample_sn); // TODO: where does WHID come from?

#endif // CONFIG_USB_DEVICE_STACK_NEXT

int main(void)
{
#if defined(CLOCK_FEATURE_HFCLK_DIVIDE_PRESENT) || NRF_CLOCK_HAS_HFCLK192M
	// Run nrf5340 app core at full speed (128 MHz)
	nrfx_clock_divider_set(NRF_CLOCK_DOMAIN_HFCLK, NRF_CLOCK_HFCLK_DIV_1);
#endif
	init_leds();
	init_button();
	
#ifdef CONFIG_USB_DEVICE_STACK_NEXT
	int add_config_result = usbd_add_configuration(&usbd, USBD_SPEED_FS,
				     &sample_fs_config);
					 
	printk("usbd_add_configuration result %d\n", add_config_result);
	int register_result =  usbd_register_class(&usbd, "midi", USBD_SPEED_FS, 1);
	printk("usbd_register_class result %d\n", register_result);

	int err = usbd_add_descriptor(&usbd, &sample_lang);
	if (err) {
		LOG_ERR("Failed to initialize language descriptor (%d)", err);
	}

	err = usbd_add_descriptor(&usbd, &sample_mfr);
	if (err) {
		LOG_ERR("Failed to initialize manufacturer descriptor (%d)", err);
	}

	err = usbd_add_descriptor(&usbd, &sample_product);
	if (err) {
		LOG_ERR("Failed to initialize product descriptor (%d)", err);
	}

	err = usbd_add_descriptor(&usbd, &sample_sn);
	if (err) {
		LOG_ERR("Failed to initialize SN descriptor (%d)", err);
	}

	int init_result = usbd_init(&usbd);
	printk("usbd_init result %d\n", init_result);
	int enable_result = usbd_enable(&usbd);
	printk("usbd_enable result %d\n", enable_result);
#endif // CONFIG_USB_DEVICE_STACK_NEXT

	k_work_init(&button_press_work, on_button_press);
	k_work_init(&event_tx_work, on_event_tx);
	k_work_init_delayable(&rx_led_off_work, on_rx_led_off);
	k_work_init_delayable(&tx_led_off_work, on_tx_led_off);

	/* Register USB MIDI callbacks */
	struct usb_midi_cb_t callbacks = {.available_cb = usb_midi_available_cb,
					  .tx_done_cb = usb_midi_tx_done_cb,
					  .midi_message_cb = midi_message_cb,
					  .sysex_data_cb = sysex_data_cb,
					  .sysex_end_cb = sysex_end_cb,
					  .sysex_start_cb = sysex_start_cb};
	usb_midi_register_callbacks(&callbacks);

#ifdef CONFIG_USB_DEVICE_STACK
	/* Init USB */
	int enable_rc = usb_enable(NULL);
	__ASSERT(enable_rc == 0, "Failed to enable USB");
#endif

	/* Send MIDI messages periodically */
	while (1) {
		
#ifdef CONFIG_TX_PERIODIC_NOTE_ENABLED
		k_work_submit(&event_tx_work);
#endif
		k_msleep(CONFIG_TX_PERIODIC_NOTE_INTERVAL_MS);
	}
}
```

## src/usb_midi.c
```c
#include <zephyr/init.h>
#include <zephyr/usb/usb_device.h>
#include <zephyr/logging/log.h>
#include "usb_midi.h"
#include "usb_midi_internal.h"

BUILD_ASSERT((USB_MIDI_NUM_INPUTS + USB_MIDI_NUM_OUTPUTS > 0), "USB MIDI device must have more than 0 ports");

#define INIT_AC_CS_IF                                         \
	{                                                           \
		.bLength = sizeof(struct usb_midi_ac_if_descriptor),      \
		.bDescriptorType = USB_DESC_CS_INTERFACE,                 \
		.bDescriptorSubtype = 0x01,                               \
		.bcdADC = 0x0100,                                         \
		.wTotalLength = sizeof(struct usb_midi_ac_if_descriptor), \
		.bInCollection = 0x01,                                    \
		.baInterfaceNr = 0x01                                     \
	}

#define INIT_MS_IF                                       \
	{                                                      \
		.bLength = sizeof(struct usb_if_descriptor),         \
		.bDescriptorType = USB_DESC_INTERFACE,               \
		.bInterfaceNumber = 0x01,                            \
		.bAlternateSetting = 0x00,                           \
		.bNumEndpoints = NUM_ENDPOINTS,                      \
		.bInterfaceClass = 0x01,				/* TODO: Constant */ \
				.bInterfaceSubClass = 0x03, /* TODO: Constant */ \
				.bInterfaceProtocol = 0x00,                      \
		.iInterface = 0x00                                   \
	}

#define INIT_MS_CS_IF(total_length)                      \
	{                                                      \
		.bLength = sizeof(struct usb_midi_ms_if_descriptor), \
		.bDescriptorType = USB_DESC_CS_INTERFACE,            \
		.bDescriptorSubtype = 0x01,                          \
		.BcdADC = 0x0100,                                    \
		.wTotalLength = total_length                         \
	}

#define INIT_IN_JACK(idx, idx_offset, jack_type)           \
	{                                                        \
		.bLength = sizeof(struct usb_midi_in_jack_descriptor), \
		.bDescriptorType = USB_DESC_CS_INTERFACE,              \
		.bDescriptorSubtype = 0x02,                            \
		.bJackType = jack_type,                                \
		.bJackID = 1 + idx + idx_offset,                       \
		.iJack = 0x00,                                         \
	}

#define INIT_OUT_JACK(idx, jack_id_idx_offset, source_id_idx_offset, jack_type) \
	{                                                                             \
		.bLength = sizeof(struct usb_midi_out_jack_descriptor),                     \
		.bDescriptorType = USB_DESC_CS_INTERFACE,                                   \
		.bDescriptorSubtype = 0x03,                                                 \
		.bJackType = jack_type,                                                     \
		.bJackID = 1 + idx + jack_id_idx_offset,                                    \
		.bNrInputPins = 0x01,                                                       \
		.BaSourceID = 1 + idx + source_id_idx_offset,                               \
		.BaSourcePin = 0x01,                                                        \
		.iJack = 0x00                                                               \
	}

#define INIT_OUT_EP                              \
	{                                              \
		.bLength = sizeof(struct usb_ep_descriptor_padded), \
		.bDescriptorType = USB_DESC_ENDPOINT,        \
		.bEndpointAddress = 0x01,                    \
		.bmAttributes = 0x02,                        \
		.wMaxPacketSize = 0x0040,                    \
		.bInterval = 0x00,                            \
		.bRefresh = 0x00, \
    .bSynchAddress = 0x00, \
	}

#define JACK_ID(x, first_id) (x + first_id)
#define INIT_OUT_CS_EP(num_embedded_jacks, embedded_in_jack_id)       \
	{                                                                   \
		.bLength = sizeof(struct usb_midi_bulk_out_ep_descriptor),        \
		.bDescriptorType = USB_DESC_CS_ENDPOINT,                          \
		.bDescriptorSubtype = 0x01,                                       \
		.bNumEmbMIDIJack = num_embedded_jacks,                            \
		.BaAssocJackID = {                                                \
			LISTIFY(num_embedded_jacks, JACK_ID, (, ), embedded_in_jack_id) \
		}                                                                 \
	}

#define INIT_IN_EP                               \
	{                                              \
		.bLength = sizeof(struct usb_ep_descriptor_padded), \
		.bDescriptorType = USB_DESC_ENDPOINT,        \
		.bEndpointAddress = 0x81,                    \
		.bmAttributes = 0x02,                        \
		.wMaxPacketSize = 0x0040,                    \
		.bInterval = 0x00,                            \
		.bRefresh = 0x00, \
    .bSynchAddress = 0x00, \
	}

#define INIT_IN_CS_EP(num_embedded_jacks, embedded_out_jack_id)        \
	{                                                                    \
		.bLength = sizeof(struct usb_midi_bulk_in_ep_descriptor),          \
		.bDescriptorType = USB_DESC_CS_ENDPOINT,                           \
		.bDescriptorSubtype = 0x01,                                        \
		.bNumEmbMIDIJack = num_embedded_jacks,                             \
		.BaAssocJackID = {                                                 \
			LISTIFY(num_embedded_jacks, JACK_ID, (, ), embedded_out_jack_id) \
		}                                                                  \
	}

#define INIT_DEVICE_DESC                               \
	{                                                    \
		.bLength = sizeof(struct usb_device_descriptor),   \
		.bDescriptorType = USB_DESC_DEVICE,                \
		.bcdUSB = 0x0110,                                  \
		.bDeviceClass = 0x00,                              \
		.bDeviceSubClass = 0x00,                           \
		.bDeviceProtocol = 0x00,                           \
		.bMaxPacketSize0 = 64,		/* 0x08 */               \
				.idVendor = 0x2FE3,		/* TODO: set properly */ \
				.idProduct = 0x1,			/* TODO: set properly */ \
				.bcdDevice = 0x0,			/* TODO: set properly */ \
				.iManufacturer = 0x1, /* TODO: set properly */ \
				.iProduct = 0x2,			/* TODO: set properly */ \
				.iSerialNumber = 0x0, /* TODO: set properly */ \
				.bNumConfigurations = 0x1                      \
	}

#define INIT_CFG_DESC(total_length)                 \
	{                                                 \
		.bLength = sizeof(struct usb_cfg_descriptor),   \
		.bDescriptorType = USB_DESC_CONFIGURATION,      \
		.wTotalLength = total_length,                   \
		.bNumInterfaces = 0x02,                         \
		.bConfigurationValue = 0x01,                    \
		.iConfiguration = 0x00,                         \
		.bmAttributes = 0x80,	 /* TODO: set properly */ \
				.bMaxPower = 0x32, /* TODO: set properly */ \
	}

#define INIT_AC_IF                                       \
	{                                                      \
		.bLength = sizeof(struct usb_if_descriptor),         \
		.bDescriptorType = USB_DESC_INTERFACE,               \
		.bInterfaceNumber = 0,                               \
		.bAlternateSetting = 0,                              \
		.bNumEndpoints = 0,                                  \
		.bInterfaceClass = 0x01,				/* TODO: Constant */ \
				.bInterfaceSubClass = 0x01, /* TODO: Constant */ \
				.bInterfaceProtocol = 0x00,                      \
		.iInterface = 0x00                                   \
	}

// The number of endpoints. Hardcoded to 2: one in and one out.
#define NUM_ENDPOINTS 2

// Value for the wTotalLength field of the class-specific MS Interface Descriptor,
// i.e the total number of bytes following the class-specific MS Interface Descriptor.
#define MIDI_MS_IF_DESC_TOTAL_SIZE                                         \
	(                                                                        \
			sizeof(struct usb_midi_in_jack_descriptor) * USB_MIDI_NUM_INPUTS +   \
			sizeof(struct usb_midi_out_jack_descriptor) * USB_MIDI_NUM_INPUTS +  \
			sizeof(struct usb_midi_in_jack_descriptor) * USB_MIDI_NUM_OUTPUTS +  \
			sizeof(struct usb_midi_out_jack_descriptor) * USB_MIDI_NUM_OUTPUTS + \
			sizeof(struct usb_ep_descriptor_padded) +                                   \
			sizeof(struct usb_midi_bulk_out_ep_descriptor) +                     \
			sizeof(struct usb_ep_descriptor_padded) +                                   \
			sizeof(struct usb_midi_bulk_in_ep_descriptor))

// Value for the wTotalLength field of the Configuration Descriptor.
#define CFG_TOTAL_LENGTH                         \
	(                                              \
			sizeof(struct usb_cfg_descriptor) +        \
			sizeof(struct usb_if_descriptor) +         \
			sizeof(struct usb_midi_ac_if_descriptor) + \
			sizeof(struct usb_if_descriptor) +         \
			sizeof(struct usb_midi_ms_if_descriptor) + \
			MIDI_MS_IF_DESC_TOTAL_SIZE)

BUILD_ASSERT(sizeof(struct usb_midi_config) == (CFG_TOTAL_LENGTH + sizeof(struct usb_device_descriptor)), "");

USBD_DEVICE_DESCR_DEFINE(primary)
struct usb_midi_config usb_midi_config_data = {
		.dev = INIT_DEVICE_DESC,
		.cfg = INIT_CFG_DESC(CFG_TOTAL_LENGTH),
		.ac_if = INIT_AC_IF,
		.ac_cs_if = INIT_AC_CS_IF,
		.ms_if = INIT_MS_IF,
		.ms_cs_if = INIT_MS_CS_IF(MIDI_MS_IF_DESC_TOTAL_SIZE),
		.in_jacks_ext = { LISTIFY(USB_MIDI_NUM_OUTPUTS, INIT_IN_JACK, (, ), 0, USB_MIDI_JACK_TYPE_EXTERNAL)},
		.in_jacks_emb = { LISTIFY(USB_MIDI_NUM_INPUTS, INIT_IN_JACK, (, ), USB_MIDI_NUM_OUTPUTS, USB_MIDI_JACK_TYPE_EMBEDDED)},
		.out_jacks_emb = { LISTIFY(USB_MIDI_NUM_OUTPUTS, INIT_OUT_JACK, (, ), USB_MIDI_NUM_INPUTS + USB_MIDI_NUM_OUTPUTS, 0, USB_MIDI_JACK_TYPE_EMBEDDED)},
		.out_jacks_ext = { LISTIFY(USB_MIDI_NUM_INPUTS, INIT_OUT_JACK, (, ), USB_MIDI_NUM_INPUTS + 2 * USB_MIDI_NUM_OUTPUTS, USB_MIDI_NUM_OUTPUTS, USB_MIDI_JACK_TYPE_EXTERNAL)},
		.out_ep = INIT_OUT_EP,
		.out_cs_ep = INIT_OUT_CS_EP(USB_MIDI_NUM_INPUTS, USB_MIDI_NUM_OUTPUTS + 1),
		.in_ep = INIT_IN_EP,
		.in_cs_ep = INIT_IN_CS_EP(USB_MIDI_NUM_OUTPUTS, USB_MIDI_NUM_INPUTS + USB_MIDI_NUM_OUTPUTS + 1),
};

static bool usb_midi_is_enabled = false;
static struct usb_midi_handlers handlers = {
		.enabled_cb = NULL,
		.rx_cb = NULL};

static void log_packet(struct usb_midi_packet *packet)
{
	printk("USB MIDI packet %02x %02x %02x %02x | cable %02x | CIN %01x | %d MIDI bytes\n",
				 packet->bytes[0], packet->bytes[1], packet->bytes[2], packet->bytes[3],
				 packet->cable_num, packet->cin, packet->num_midi_bytes);
}

static void packet_from_midi_bytes(uint8_t *midi_bytes, uint8_t num_midi_bytes, uint8_t cable_num, struct usb_midi_packet *packet)
{
	packet->cable_num = cable_num;
	packet->num_midi_bytes = num_midi_bytes;

	uint8_t first_byte = midi_bytes[0];

	// TODO: actually compute CIN
	enum usb_midi_cin cin = (first_byte & 0xf0) >> 4;
	packet->cin = cin;

	// Put cable number and CIN in packet byte 0
	packet->bytes[0] = (cable_num << 4) | cin;

	// Fill packet bytes 1,2 and 3 with zero padded midi bytes.
	for (int i = 0; i < 3; i++)
	{
		uint8_t midi_byte = i < num_midi_bytes ? midi_bytes[i] : 0;
		packet->bytes[i + 1] = midi_byte;
	}
}

static void packet_from_usb_bytes(uint8_t packet_bytes[4], struct usb_midi_packet *packet)
{
	// LOG_DBG("Parsing packet bytes %02x %02x %02x %02x", packet_bytes[0], packet_bytes[1], packet_bytes[2], packet_bytes[3]);

	packet->num_midi_bytes = 0;

	packet->bytes[0] = packet_bytes[0];
	packet->bytes[1] = packet_bytes[1];
	packet->bytes[2] = packet_bytes[2];
	packet->bytes[3] = packet_bytes[3];

	packet->cable_num = (packet_bytes[0] & 0xf0) >> 4;
	packet->cin = packet_bytes[0] & 0xf;

	switch (packet->cin)
	{
	case USB_MIDI_CIN_MISC:
	case USB_MIDI_CIN_CABLE_EVENT:
		// Reserved for future expansion. Set the byte count at 0 to
		// indicate that this packet should be ignored.
		// LOG_WRN("Got reserved code index number %d", packet->cin);
		packet->num_midi_bytes = 0;
		break;
	case USB_MIDI_CIN_SYSEX_END_1BYTE:
	case USB_MIDI_CIN_1BYTE_DATA:
		packet->num_midi_bytes = 1;
		break;
	case USB_MIDI_CIN_SYSCOM_2BYTE:
	case USB_MIDI_CIN_SYSEX_END_2BYTE:
	case USB_MIDI_CIN_PROGRAM_CHANGE:
	case USB_MIDI_CIN_CHANNEL_PRESSURE:
		packet->num_midi_bytes = 2;
		break;
	default:
		packet->num_midi_bytes = 3;
		break;
	}

	// LOG_DBG("Parsed packet cin %d, num_midi_bytes %d", packet->cin, packet->num_midi_bytes);
}

void usb_midi_register_handlers(struct usb_midi_handlers *h)
{
	handlers.enabled_cb = h->enabled_cb;
	handlers.rx_cb = h->rx_cb;
}

static void midi_out_ep_cb(uint8_t ep, enum usb_dc_ep_cb_status_code
																					 ep_status)
{
	uint8_t buf[4];
	uint32_t num_read_bytes = 0;
	usb_read(ep, buf, 4, &num_read_bytes);
	struct usb_midi_packet packet;
	packet_from_usb_bytes(buf, &packet);
	if (handlers.rx_cb && packet.num_midi_bytes)
	{
		handlers.rx_cb(packet.cable_num, &packet.bytes[1], packet.num_midi_bytes);
	}
	// printk("rx ");
	// log_packet(&packet);
	// usb_read(ep, NULL, 0, &bytes_to_read);
	// LOG_DBG("ep 0x%x, bytes to read %d ", ep, bytes_to_read);
	// usb_read(ep, loopback_buf, bytes_to_read, NULL);
}

static void midi_in_ep_cb(uint8_t ep, enum usb_dc_ep_cb_status_code
																					ep_status)
{
	// LOG_DBG("midi_out_cb ep %d, ep_status %d\n", ep, ep_status);
	/* if (usb_write(ep, loopback_buf, CONFIG_LOOPBACK_BULK_EP_MPS,
			NULL)) {
		LOG_DBG("ep 0x%x", ep);
	} */
}

static struct usb_ep_cfg_data midi_ep_cfg[] = {
		{
				.ep_cb = midi_in_ep_cb,
				.ep_addr = 0x81,
		},
		{
				.ep_cb = midi_out_ep_cb,
				.ep_addr = 0x01,
		},
};

void usb_status_callback(struct usb_cfg_data *cfg,
												 enum usb_dc_status_code cb_status,
												 const uint8_t *param)
{
	switch (cb_status)
	{
	/** USB error reported by the controller */
	case USB_DC_ERROR:
		// printk("USB_DC_ERROR\n");
		break;
	/** USB reset */
	case USB_DC_RESET:
		// printk("USB_DC_RESET\n");
		break;
	/** USB connection established, hardware enumeration is completed */
	case USB_DC_CONNECTED:
		// printk("USB_DC_CONNECTED\n");
		break;
	/** USB configuration done */
	case USB_DC_CONFIGURED:
		if (!usb_midi_is_enabled && handlers.enabled_cb)
		{
			handlers.enabled_cb(true);
		}
		usb_midi_is_enabled = true;
		// printk("USB_DC_CONFIGURED\n");
		break;
	/** USB connection lost */
	case USB_DC_DISCONNECTED:
		// printk("USB_DC_DISCONNECTED\n");
		break;
	/** USB connection suspended by the HOST */
	case USB_DC_SUSPEND:
		if (usb_midi_is_enabled && handlers.enabled_cb)
		{
			handlers.enabled_cb(false);
		}
		usb_midi_is_enabled = false;
		// printk("USB_DC_SUSPEND\n");
		break;
	/** USB connection resumed by the HOST */
	case USB_DC_RESUME:
		// printk("USB_DC_RESUME\n");
		break;
	/** USB interface selected */
	case USB_DC_INTERFACE:
		// printk("USB_DC_INTERFACE\n");
		break;
	/** Set Feature ENDPOINT_HALT received */
	case USB_DC_SET_HALT:
		// printk("USB_DC_SET_HALT\n");
		break;
	/** Clear Feature ENDPOINT_HALT received */
	case USB_DC_CLEAR_HALT:
		// printk("USB_DC_CLEAR_HALT\n");
		break;
	/** Start of Frame received */
	case USB_DC_SOF:
		// printk("USB_DC_SOF\n");
		break;
	/** Initial USB connection status */
	case USB_DC_UNKNOWN:
		// printk("USB_DC_UNKNOWN\n");
		break;
	}
}

uint32_t usb_midi_tx(uint8_t cable_number, uint8_t *midi_bytes, uint8_t midi_byte_count)
{
	struct usb_midi_packet packet;
	packet_from_midi_bytes(midi_bytes, midi_byte_count, cable_number, &packet);
	// printk("tx ");
	// log_packet(&packet);
	uint32_t num_written_bytes = 0;
	usb_write(0x81, packet.bytes, 4, &num_written_bytes);
	return num_written_bytes;
}

USBD_DEFINE_CFG_DATA(usb_midi_config) = {
		.usb_device_description = &usb_midi_config_data,
		.interface_config = NULL,
		.interface_descriptor = &usb_midi_config_data.ac_if,
		.cb_usb_status = usb_status_callback,
		.interface = {
				.class_handler = NULL,
				.custom_handler = NULL,
				.vendor_handler = NULL,
		},
		.num_endpoints = ARRAY_SIZE(midi_ep_cfg),
		.endpoint = midi_ep_cfg,
};
```

## src/usb_midi.h
```c
#ifndef ZEPHYR_USB_MIDI_H_
#define ZEPHYR_USB_MIDI_H_

#include <zephyr/init.h>

/* A function to call when MIDI data has been received. */
typedef void (*usb_midi_rx_cb)(uint8_t cable_number, uint8_t* midi_bytes, uint8_t midi_byte_count);
/* A function to call when the USB MIDI device becomes available/unavailable. */
typedef void (*usb_midi_enabled_cb)(bool is_available);

struct usb_midi_handlers {
    usb_midi_rx_cb rx_cb;
    usb_midi_enabled_cb enabled_cb;
};

/* Register callbacks to invoke when receiving MIDI data etc. */
void usb_midi_register_handlers(struct usb_midi_handlers* handlers);
/* Send a midi event. */
uint32_t usb_midi_tx(uint8_t cable_number, uint8_t* midi_bytes, uint8_t midi_byte_count);

#endif
```

## src/usb_midi_internal.h
```c
#ifndef ZEPHYR_USB_MIDI_INTERNAL_H_
#define ZEPHYR_USB_MIDI_INTERNAL_H_

#include <zephyr/init.h>

// A USB MIDI data packet.
struct usb_midi_packet
{
        uint8_t cin;
        uint8_t cable_num;
        uint8_t bytes[4];
        uint8_t num_midi_bytes;
};

// The number of MIDI input ports
#define USB_MIDI_NUM_INPUTS CONFIG_USB_MIDI_NUM_INPUTS
// The number of MIDI output ports
#define USB_MIDI_NUM_OUTPUTS CONFIG_USB_MIDI_NUM_OUTPUTS

// Code Index Numbers. See table 4-1 in the spec.
enum usb_midi_cin
{
        USB_MIDI_CIN_MISC = 0x0,
        USB_MIDI_CIN_CABLE_EVENT = 0x1,
        USB_MIDI_CIN_SYSCOM_2BYTE = 0x2,
        USB_MIDI_CIN_SYSCOM_3BYTE = 0x3,
        USB_MIDI_CIN_SYSEX_START = 0x4,
        USB_MIDI_CIN_SYSEX_END_1BYTE = 0x5,
        USB_MIDI_CIN_SYSEX_END_2BYTE = 0x6,
        USB_MIDI_CIN_SYSEX_END_3BYTE = 0x7,
        USB_MIDI_CIN_NOTE_ON = 0x8,
        USB_MIDI_CIN_NOTE_OFF = 0x9,
        USB_MIDI_CIN_POLY_KEYPRESS = 0xA,
        USB_MIDI_CIN_CONTROL_CHANGE = 0xB,
        USB_MIDI_CIN_PROGRAM_CHANGE = 0xC,
        USB_MIDI_CIN_CHANNEL_PRESSURE = 0xD,
        USB_MIDI_CIN_PITCH_BEND_CHANGE = 0xE,
        USB_MIDI_CIN_1BYTE_DATA = 0xF
};

// MS (MIDI streaming) Class-Specific Interface Descriptor Subtypes. See table A.1 in the spec.
enum usb_midi_if_desc_subtype
{
        USB_MIDI_IF_DESC_UNDEFINED = 0x00,
        USB_MIDI_IF_DESC_MS_HEADER = 0x01,
        USB_MIDI_IF_DESC_MIDI_IN_JACK = 0x02,
        USB_MIDI_IF_DESC_MIDI_OUT_JACK = 0x03,
        USB_MIDI_IF_DESC_ELEMENT = 0x04
};

// MS Class-Specific Endpoint Descriptor Subtypes. See table A.2 in the spec.
enum usb_midi_ep_desc_subtype
{
        USB_MIDI_EP_DESC_UNDEFINED = 0x00,
        USB_MIDI_EP_DESC_MS_GENERAL = 0x01
};

// MS MIDI IN and OUT Jack types. See table A.3 in the spec.
enum usb_midi_jack_type
{
        USB_MIDI_JACK_TYPE_UNDEFINED = 0x00,
        USB_MIDI_JACK_TYPE_EMBEDDED = 0x01,
        USB_MIDI_JACK_TYPE_EXTERNAL = 0x02
};

// Class-specific AC (audio control) Interface Descriptor.
struct usb_midi_ac_if_descriptor
{
        uint8_t bLength;
        uint8_t bDescriptorType;
        uint8_t bDescriptorSubtype;
        uint16_t bcdADC;
        uint16_t wTotalLength;
        uint8_t bInCollection;
        uint8_t baInterfaceNr;
} __packed;

// Class-Specific MS Interface Header Descriptor. See table 6.2 in the spec.
struct usb_midi_ms_if_descriptor
{
        // Size of this descriptor, in bytes
        uint8_t bLength;
        // CS_INTERFACE descriptor type
        uint8_t bDescriptorType;
        // MS_HEADER descriptor subtype.
        uint8_t bDescriptorSubtype;
        // MIDIStreaming SubClass Specification Release Number in Binary-Coded Decimal.
        // Currently 01.00.
        uint16_t BcdADC;
        // Total number of bytes returned for the class-specific MIDIStreaming interface descriptor.
        // Includes the combined length of this descriptor header and all Jack and Element descriptors.
        uint16_t wTotalLength;
} __packed;

// MIDI IN Jack Descriptor. See table 6.3 in the spec.
struct usb_midi_in_jack_descriptor
{
        // Size of this descriptor, in bytes.
        uint8_t bLength;
        // CS_INTERFACE descriptor type.
        uint8_t bDescriptorType;
        // MIDI_IN_JACK descriptor subtype.
        uint8_t bDescriptorSubtype;
        // EMBEDDED or EXTERNAL
        uint8_t bJackType;
        // Constant uniquely identifying the MIDI IN Jack within the USB-MIDI function.
        uint8_t bJackID;
        // Index of a string descriptor, describing the MIDI IN Jack.
        uint8_t iJack;
} __packed;

// MIDI OUT Jack Descriptor. See table 6.4 in the spec.
struct usb_midi_out_jack_descriptor
{
        // Size of this descriptor, in bytes:
        uint8_t bLength;
        // CS_INTERFACE descriptor type.
        uint8_t bDescriptorType;
        // MIDI_OUT_JACK descriptor subtype.
        uint8_t bDescriptorSubtype;
        // EMBEDDED or EXTERNAL
        uint8_t bJackType;
        // Constant uniquely identifying the MIDI OUT Jack within the USB-MIDI function.
        uint8_t bJackID;
        // Number of Input Pins of this MIDI OUT Jack (assumed to be 1 in this implementation).
        uint8_t bNrInputPins;
        // ID of the Entity to which the first Input Pin of this MIDI OUT Jack is connected.
        uint8_t BaSourceID;
        // Output Pin number of the Entity to which the first Input Pin of this MIDI OUT Jack is connected.
        uint8_t BaSourcePin;
        // Index of a string descriptor, describing the MIDI OUT Jack.
        uint8_t iJack;
} __packed;

struct usb_ep_descriptor_padded
{
        uint8_t bLength;
        uint8_t bDescriptorType;
        uint8_t bEndpointAddress;
        uint8_t bmAttributes;
        uint16_t wMaxPacketSize;
        uint8_t bInterval;
        uint8_t bRefresh;
        uint8_t bSynchAddress;
} __packed;

// Class-Specific MS Bulk Data Endpoint Descriptor corresponding to a MIDI output.
// See table 6-7 in the spec.
struct usb_midi_bulk_out_ep_descriptor
{
        uint8_t bLength;
        uint8_t bDescriptorType;
        uint8_t bDescriptorSubtype;
        uint8_t bNumEmbMIDIJack;
        uint8_t BaAssocJackID[USB_MIDI_NUM_INPUTS];
} __packed;

// Class-Specific MS Bulk Data Endpoint Descriptor corresponding to a MIDI input.
// See table 6-7 in the spec.
struct usb_midi_bulk_in_ep_descriptor
{
        uint8_t bLength;
        uint8_t bDescriptorType;
        uint8_t bDescriptorSubtype;
        uint8_t bNumEmbMIDIJack;
        uint8_t BaAssocJackID[USB_MIDI_NUM_OUTPUTS];
} __packed;

// Element descriptor.
// See table 6-5 in the spec.
/* struct usb_midi_element_descriptor
{
        uint8_t bLength;
        uint8_t bDescriptorType;
        uint8_t bDescriptorSubtype;
        uint8_t bElementID;
        uint8_t bNrInputPins;
        {
            uint8_t baSourceID
                uint8_t baSourcePin}[NUM_ELEMENT_INPUTS];
        uint8_t bNrOutputPins;
        uint8_t bInTerminalLink;
        uint8_t bOutTerminalLink;
        uint8_t bElCapsSize;
        uint8_t bmElementCaps[ELEMENT_CAPS_COUNT];
        uint8_t iElement;
} __packed; */

// A complete set of descriptors for a USB MIDI device.
// Similar to the example in appendix B of the spec, but
// adapted to support any valid numbers of input and output ports.
struct usb_midi_config
{
        struct usb_device_descriptor dev;
        struct usb_cfg_descriptor cfg;
        struct usb_if_descriptor ac_if;
        struct usb_midi_ac_if_descriptor ac_cs_if;
        struct usb_if_descriptor ms_if;
        struct usb_midi_ms_if_descriptor ms_cs_if;
        struct usb_midi_in_jack_descriptor in_jacks_ext[USB_MIDI_NUM_OUTPUTS];
        struct usb_midi_in_jack_descriptor in_jacks_emb[USB_MIDI_NUM_INPUTS];
        struct usb_midi_out_jack_descriptor out_jacks_emb[USB_MIDI_NUM_OUTPUTS];
        struct usb_midi_out_jack_descriptor out_jacks_ext[USB_MIDI_NUM_INPUTS];
        struct usb_ep_descriptor_padded out_ep;
        struct usb_midi_bulk_out_ep_descriptor out_cs_ep;
        struct usb_ep_descriptor_padded in_ep;
        struct usb_midi_bulk_in_ep_descriptor in_cs_ep;
} __packed;

#endif
```
